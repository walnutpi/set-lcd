/dts-v1/;
/plugin/;

// #include <dt-bindings/gpio/gpio.h>
// #include <dt-bindings/gpio/sun4i-gpio.h>
// #include <dt-bindings/leds/common.h>
/ {
	fragment@0 {
		target = <&spi1>;
		__overlay__ {
			#address-cells = <1>;
			#size-cells = <0>;
			status = "okay";
			lcd@0{
				compatible = "walnutpi,lcd15_st7789";
				reg = <0>;
				spi-max-frequency = <30000000>;
				status = "okay";
				
				dc-gpios = <&pio  8 9 0>;
				reset-gpios = <&pio 8 7 1>;
				rotate = <270>;
				buswidth = <8>;
				regwidth = <10>;
				fps = <30>;
				bgr = <0> ;
				debug = <0x00>;
			};
			
		};
	};
	
	fragment@1 {
		target = <&spi1>;
		__overlay__ {
			status = "okay";
			#address-cells = <1>;
			#size-cells = <0>;
			
			spidev@0 {
				status = "disabled";
				reg = <0x0>;
			};
			
			spidev@1 {
				status = "disabled";
				reg = <0x1>;
			};
		};
	};
};

